## config/boards/shields/cygnus/Kconfig.defconfig
```kconfig
config ZMK_SPLIT
  default y

config ZMK_BLE
  default y

config ZMK_BLE_EXPERIMENTAL_FEATURES
  default y

if SHIELD_DONGLE
  config ZMK_KEYBOARD_NAME
    default "Cygnus Dongle"

  config ZMK_SPLIT_ROLE_CENTRAL
    default y

  config ZMK_SPLIT_BLE_CENTRAL_PERIPHERALS
    default 2

  config ZMK_SLEEP
    default y

  config BT_MAX_CONN
    default 7

  config BT_MAX_CONN
    default 7
endif
```

## config/boards/shields/dongle/Kconfig.defconfig
```kconfig
if SHIELD_DONGLE
  config ZMK_KEYBOARD_NAME
    default "Dongle"

  config ZMK_SPLIT_ROLE_CENTRAL
    default y

  config ZMK_SPLIT
    default y

  config ZMK_SPLIT_BLE_CENTRAL_PERIPHERALS
    default 2

  config ZMK_BLE_EXPERIMENTAL_FEATURES
    default y

  config ZMK_SLEEP
    default y

  endif
```
