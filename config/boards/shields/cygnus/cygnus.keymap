/*
 * Copyright (c) 2020 The ZMK Contributors
 *
 * SPDX-License-Identifier: MIT
 */

/* #include <behaviors.dtsi> */
/* #include <dt-bindings/zmk/keys.h> */
/* #include <dt-bindings/zmk/bt.h> */
#include "../../../../miryoku/custom_config.h"
#include "../../../../miryoku/mapping/36/cygnus.h"
#include "../../../../miryoku/miryoku.dtsi"

/* / { */
/*   keymap { */
/*     compatible = "zmk,keymap"; */
/**/
/*     default_layer { */
/*       bindings = < */
/* &kp Q &kp W &kp E &kp R &kp T       &kp Y   &kp U &kp I     &kp O   &kp P */
/* &kp A &kp S &kp D &kp F &kp G       &kp H   &kp J &kp K     &kp L   &kp SEMI */
/* &kp Z &kp X &kp C &kp V &kp B       &kp N   &kp M &kp COMMA &kp DOT &kp MINUS */
/*         &kp Q &kp Q &kp SPACE       &kp RET &kp Q &kp RALT */
/*       >; */
/*     }; */
/*   }; */
/* }; */
